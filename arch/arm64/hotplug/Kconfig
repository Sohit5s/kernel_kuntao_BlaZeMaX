## arch/arm64/hotplug/Kconfig
```kconfig
menu "Custom Hotplug drivers"

config CUSTOM_HOTPLUG
	bool "Enable custom hotplug support"

config MSM_HOTPLUG
	bool "MSM hotplug by [Fluxi]"
	depends on HOTPLUG_CPU
	default n
	help
	  The MSM hotplug driver controls on-/offlining of additional cores based on current cpu load.

config BLU_PLUG
	bool "Dynamic hotplug driver"
	depends on HOTPLUG_CPU
	default n
	help
          The Dynamic hotplug driver automatically online/offline CPUs proportional to system load.

config ALUCARD_HOTPLUG
	bool "Alucard hotplug"
 	default n
 	help
 	  Generic Alucard-hotplug cpu hotplug driver for ARM SOCs

config INTELLI_HOTPLUG
	bool "Intelli hotplug driver"
	depends on HOTPLUG_CPU
	default n
	help
	  An intelligent cpu hotplug driver for
	  Low Latency Frequency Transition capable processors.
  
config LAZYPLUG
	bool "Lazyplug Conservative hotplugging for generic devices"
	default n
	help
	  an All in One HotPlug for Traditional Quad-Core SoCs and
	  Hexa/Octa-Core big.LITTLE SoCs.

config INTELLI_HOTPLUG
	bool "Intelli hotplug driver"
	depends on HOTPLUG_CPU
	default n
	help
	  An intelligent cpu hotplug driver for
	  Low Latency Frequency Transition capable processors.

  
config LAZYPLUG
	bool "Lazyplug Conservative hotplugging for generic devices"
	default n
	help
	  This enables the conservative hotplugging, lazyplug by arter97
	  based on intelli_plug. Refer to the comments for more info.
```
